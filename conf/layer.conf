## conf/layer.conf
```bitbake
# We have a conf and classes directory, add to BBPATH
BBPATH .= ":${LAYERDIR}"

# We have recipes-* directories, add to BBFILES
BBFILES += "${LAYERDIR}/recipes-*/*/*.bb \
            ${LAYERDIR}/recipes-*/*/*.bbappend"

BBFILE_COLLECTIONS += "meta-mio"
BBFILE_PATTERN_meta-mio = "^${LAYERDIR}/"
BBFILE_PRIORITY_meta-mio = "6"

LAYERDEPENDS_meta-mio = "core"
LAYERSERIES_COMPAT_meta-mio = "kirkstone"
```
